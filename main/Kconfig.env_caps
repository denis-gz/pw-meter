## main/Kconfig.env_caps
```kconfig
config ENV_GPIO_RANGE_MIN
    int
    default 0

config ENV_GPIO_RANGE_MAX
    int
    default 48

config ENV_GPIO_IN_RANGE_MAX
    int
    default ENV_GPIO_RANGE_MAX

config ENV_GPIO_OUT_RANGE_MAX
    int
    default ENV_GPIO_RANGE_MAX

config ENV_I2C_ADDR_RANGE_MIN
    hex
    default 0x08

config ENV_I2C_ADDR_RANGE_MAX
    hex
    default 0x77
```

## main/Kconfig.projbuild
```kconfig
menu "Project Configuration"

    orsource "Kconfig.env_caps"

    config PIN_BOOT_BUTTON
        int "Pin number of BOOT button"
        range ENV_GPIO_RANGE_MIN ENV_GPIO_OUT_RANGE_MAX
        default 0

    config PIN_ENCODER_A
        int "Pin number of rotary encoder channel A output"
        range ENV_GPIO_RANGE_MIN ENV_GPIO_OUT_RANGE_MAX
        default 18

    config PIN_ENCODER_B
        int "Pin number of rotary encoder channel B output"
        range ENV_GPIO_RANGE_MIN ENV_GPIO_OUT_RANGE_MAX
        default 17

    config PIN_ENCODER_KEY
        int "Pin number of rotary encoder key output"
        range ENV_GPIO_RANGE_MIN ENV_GPIO_OUT_RANGE_MAX
        default 16

    config PIN_LED
        int "Pin number of LED (pull-down, active high)"
        range ENV_GPIO_RANGE_MIN ENV_GPIO_OUT_RANGE_MAX
        default 1

    config PIN_ADC_V
        int "Pin number of ADC_V channel input"
        range ENV_GPIO_RANGE_MIN ENV_GPIO_OUT_RANGE_MAX
        default 4

    config PIN_ADC_I
        int "Pin number of ADC_I channel input"
        range ENV_GPIO_RANGE_MIN ENV_GPIO_OUT_RANGE_MAX
        default 9

endmenu
```
